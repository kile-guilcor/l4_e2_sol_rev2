## build/Kconfig/boards/Kconfig.nrf54h20dk
```kconfig
# Load board Kconfig descriptions.
osource "/home/fame/ncs/v3.2.0/zephyr/boards/nordic/nrf54h20dk/Kconfig.nrf54h20dk"
```

## build/l4_e2_sol_rev2/Kconfig/arch/Kconfig
```kconfig
# Load Zephyr Arch Kconfig descriptions.
osource "/home/fame/ncs/v3.2.0/zephyr/arch/rx/Kconfig"
osource "/home/fame/ncs/v3.2.0/zephyr/arch/x86/Kconfig"
osource "/home/fame/ncs/v3.2.0/zephyr/arch/xtensa/Kconfig"
osource "/home/fame/ncs/v3.2.0/zephyr/arch/sparc/Kconfig"
osource "/home/fame/ncs/v3.2.0/zephyr/arch/riscv/Kconfig"
osource "/home/fame/ncs/v3.2.0/zephyr/arch/posix/Kconfig"
osource "/home/fame/ncs/v3.2.0/zephyr/arch/mips/Kconfig"
osource "/home/fame/ncs/v3.2.0/zephyr/arch/arm64/Kconfig"
osource "/home/fame/ncs/v3.2.0/zephyr/arch/arm/Kconfig"
osource "/home/fame/ncs/v3.2.0/zephyr/arch/arc/Kconfig"
```

## build/uicr/Kconfig/boards/Kconfig
```kconfig
# Load Zephyr board Kconfig descriptions.
osource "/home/fame/ncs/v3.2.0/zephyr/boards/nordic/nrf54h20dk/Kconfig"
config BOARD_REVISION_0_9_0
	def_bool y
```

## build/uicr/Kconfig/boards/Kconfig.sysbuild
```kconfig
# Load Sysbuild board Kconfig descriptions.
osource "/home/fame/ncs/v3.2.0/zephyr/boards/nordic/nrf54h20dk/Kconfig.sysbuild"
```
